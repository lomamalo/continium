## esp32-firmware/sdkconfig.defaults
```kconfig
# --- Console: USB Serial/JTAG, not UART ---
CONFIG_ESP_CONSOLE_USB_SERIAL_JTAG=y
CONFIG_ESP_CONSOLE_USB_SERIAL_JTAG_ENABLED=y
CONFIG_ESP_CONSOLE_UART_DEFAULT=n

# --- Bluetooth: NimBLE only, peripheral role, 1 connection max ---
CONFIG_BT_ENABLED=y
CONFIG_BT_NIMBLE_ENABLED=y
CONFIG_BT_BLUEDROID_ENABLED=n
CONFIG_BT_NIMBLE_MAX_CONNECTIONS=1
CONFIG_BT_NIMBLE_ROLE_PERIPHERAL=y
CONFIG_BT_NIMBLE_ROLE_CENTRAL=n
CONFIG_BT_NIMBLE_ROLE_OBSERVER=n
CONFIG_BT_NIMBLE_ROLE_BROADCASTER=n

# --- Flash ---
CONFIG_ESPTOOLPY_FLASHMODE_DIO=y
CONFIG_ESPTOOLPY_FLASHFREQ_80M=y
CONFIG_ESPTOOLPY_FLASHSIZE_4MB=y

# --- FreeRTOS ---
CONFIG_FREERTOS_HZ=100

# --- Optimization ---
CONFIG_COMPILER_OPTIMIZATION_SIZE=y

# --- Logging ---
CONFIG_LOG_MAXIMUM_LEVEL_INFO=y
CONFIG_LOG_DEFAULT_LEVEL_INFO=y
```
